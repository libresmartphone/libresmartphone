/dts-v1/;
/plugin/;

/ {
    compatible = "ti,beaglebone", "ti,beaglebone-black";

    /* identification */
    part-number = "BB-EEPROM-01";

    /* version */
    version = "00A0";

    fragment@0 {
        target = <&i2c2>;
        __overlay__ {
            #address-cells     = <1>;
            #size-cells     = <0>;
            status = "okay";
            clock-frequency = <100000>;

            eeprom: eeprom@50 {
                compatible = "at,24c256";
                reg = <0x50>;
            };
        };
    };
};
